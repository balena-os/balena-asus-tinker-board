## layers/meta-balena-asus-tinker-board/conf/layer.conf
```bitbake
BBPATH .= ":${LAYERDIR}"

BBFILES += "${LAYERDIR}/recipes-*/*/*.bb \
            ${LAYERDIR}/recipes-*/*/*.bbappend"

BBFILE_COLLECTIONS += "balena-asus-tinker-board"
BBFILE_PATTERN_balena-asus-tinker-board := "^${LAYERDIR}/"
BBFILE_PRIORITY_balena-asus-tinker-board = "1337"

LAYERSERIES_COMPAT_balena-asus-tinker-board = "sumo"
```

## layers/meta-resin-asus-tinker-board/conf/layer.conf
```bitbake
BBPATH .= ":${LAYERDIR}"

BBFILES += "${LAYERDIR}/recipes-*/*/*.bb \
            ${LAYERDIR}/recipes-*/*/*.bbappend"

BBFILE_COLLECTIONS += "resin-asus-tinker-board"
BBFILE_PATTERN_resin-asus-tinker-board := "^${LAYERDIR}/"
BBFILE_PRIORITY_resin-asus-tinker-board = "1337"

LAYERSERIES_COMPAT_resin-asus-tinker-board = "rocko"
```

## layers/meta-resin-asus-tinker-board/conf/machine/asus-tinker-board-s.conf
```bitbake
#@TYPE: Machine
##@NAME: asus-tinker-board-s
##@DESCRIPTION: Machine configuration for the Asus Tinker Board S

MACHINEOVERRIDES = "tinker-rk3288:${MACHINE}"
include conf/machine/tinker-rk3288.conf
```

## layers/meta-resin-asus-tinker-board/conf/machine/asus-tinker-board.conf
```bitbake
#@TYPE: Machine
##@NAME: asus-tinker-board
##@DESCRIPTION: Machine configuration for the Asus Tinker Board

MACHINEOVERRIDES = "tinker-rk3288:${MACHINE}"
include conf/machine/tinker-rk3288.conf
```
